## config/boards/shields/miryoku_mod/Kconfig.defconfig
```kconfig
if SHIELD_MIRYOKU_MOD_LEFT

config ZMK_KEYBOARD_NAME
    default "miryoku_mod"

config ZMK_SPLIT_ROLE_CENTRAL
    default y


endif

if SHIELD_MIRYOKU_MOD_LEFT || SHIELD_MIRYOKU_MOD_RIGHT

config ZMK_SPLIT
    default y

endif
```

## config/boards/shields/miryoku_mod/Kconfig.shield
```kconfig
config SHIELD_MIRYOKU_MOD_LEFT
    def_bool $(shields_list_contains,miryoku_mod_left)

config SHIELD_MIRYOKU_MOD_RIGHT
    def_bool $(shields_list_contains,miryoku_mod_right)
```
